## boards/Kconfig
```kconfig
config CAKE_PER_KEY_LED
    bool "Light a key's LED in a random rainbow colour while it is pressed"
    default y
    depends on DT_HAS_CAKE_PER_KEY_LED_ENABLED
    select LED_STRIP
    select ZMK_LOW_PRIORITY_WORK_QUEUE

if CAKE_PER_KEY_LED

config CAKE_PER_KEY_LED_BRIGHTNESS
    int "Brightness of a pressed key's LED in percent of full output"
    range 1 100
    default 20

config CAKE_PER_KEY_LED_FADE_MS
    int "Fade-out time after a key is released, in milliseconds"
    default 500

config CAKE_PER_KEY_LED_STATUS_HOLD_MS
    int "How long a tap of &kb_status keeps the status lit, in milliseconds"
    default 2000

endif # CAKE_PER_KEY_LED

config CAKE_BEHAVIOR_STATUS_LEDS
    bool "&kb_status behavior: show the battery level and OS on the per-key LEDs"
    default y
    depends on DT_HAS_CAKE_BEHAVIOR_STATUS_LEDS_ENABLED
```

## boards/dts/bindings/cake,behavior-status-leds.yaml
```yaml
description: |
  Shows keyboard status on the per-key LEDs while the key is held, then fades
  it out after release: the battery level as a bar, and the active OS layer
  as a colour. Runs on every part of a split keyboard, so each half shows its
  own battery level on its own LEDs.

compatible: "cake,behavior-status-leds"

include: zero_param.yaml

properties:
  win-layer:
    type: int
    description: |
      Layer that marks the Windows base layer. While it is active the OS
      colour shows Windows, otherwise Mac. Leave out to not show the OS.
```

## boards/dts/bindings/cake,per-key-led.yaml
```yaml
description: |
  Lights the LED under a key in a random rainbow colour while the key is
  pressed, then fades it out after release.

compatible: "cake,per-key-led"

properties:
  led-strip:
    type: phandle
    required: true
    description: The addressable LED strip (e.g. worldsemi,ws2812-spi).

  key-positions:
    type: array
    required: true
    description: |
      Keymap position for each LED, in chain order (entry 0 = first LED after
      the controller). Positions not listed have no LED.

  battery-positions:
    type: array
    description: |
      Keymap positions used as the battery level bar, from the empty end to
      the full end. Each position must also be listed in key-positions.

  os-positions:
    type: array
    description: |
      Keymap positions that show the active OS colour (white for Mac, pink for
      Windows) with the battery bar. Each position must also be listed in
      key-positions.

  bt-positions:
    type: array
    description: |
      Keymap position for each BT profile, from profile 0 up. The active
      profile's LED shows blue if its host is connected, orange if it is
      paired but not connected, and purple if no host is paired. Each
      position must also be listed in key-positions.
```
