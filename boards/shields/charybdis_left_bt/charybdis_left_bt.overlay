#include "../charybdis_common/charybdis.dtsi"
#include "../charybdis_common/charybdis_underglow.dtsi"

&kscan0 {
	compatible = "zmk,kscan-gpio-matrix";
	
	col-gpios
		= <&pro_micro 19 (GPIO_ACTIVE_HIGH | GPIO_PULL_DOWN)>
		, <&pro_micro 20 (GPIO_ACTIVE_HIGH | GPIO_PULL_DOWN)>
		, <&pro_micro 10 (GPIO_ACTIVE_HIGH | GPIO_PULL_DOWN)>
		, <&pro_micro 6 (GPIO_ACTIVE_HIGH | GPIO_PULL_DOWN)>
		, <&pro_micro 7 (GPIO_ACTIVE_HIGH | GPIO_PULL_DOWN)>
		, <&pro_micro 8 (GPIO_ACTIVE_HIGH | GPIO_PULL_DOWN)>
		;

	row-gpios
		= <&pro_micro 18 GPIO_ACTIVE_HIGH>
		, <&pro_micro 5 GPIO_ACTIVE_HIGH>
		, <&pro_micro 4 GPIO_ACTIVE_HIGH>
		, <&pro_micro 9 GPIO_ACTIVE_HIGH>
		;
};

/* One LED per key: 18 main + 3 thumb */
&led_strip {
	chain-length = <21>;
};

/*
 * Per-key LEDs: light the pressed key in a random rainbow colour.
 * Chain order (viewed from the top): zig-zag down/up the columns starting at
 * the top of the outer pinky column, then the thumbs from outer to inner.
 * Keymap positions on this half: row r spans 12r+0 (pinky) .. 12r+5 (inner);
 * thumbs are 36 (outer), 37 (middle) and 38 (inner).
 */
/ {
	per_key_led {
		compatible = "cake,per-key-led";
		led-strip = <&led_strip>;
		key-positions
			= < 0 12 24>	/* pinky col, down */
			, <25 13  1>	/* ring col, up */
			, < 2 14 26>	/* middle col, down */
			, <27 15  3>	/* index col, up */
			, < 4 16 28>	/* index inner col, down */
			, < 5 17 29>	/* innermost col (T G B), down */
			, <36 37 38>	/* thumbs: outer, middle, inner */
			;
		/* &kb_status: top row, filling from the inner column outwards */
		battery-positions = <5 4 3 2 1 0>;
		/* &kb_status: thumbs show the OS (white = Mac, pink = Windows) */
		os-positions = <36 37 38>;
		/* &kb_status: home row under the BT_SEL 0-4 keys shows the active profile */
		bt-positions = <13 14 15 16 17>;
	};
};
